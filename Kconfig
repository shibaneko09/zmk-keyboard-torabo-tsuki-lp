## Kconfig
```kconfig
config TORABO_POINTING_SETTINGS_RPC
    bool "Torabo Tsuki pointing settings Studio RPC"
    depends on ZMK_STUDIO_RPC
    default n
    help
      Enables runtime cursor and scroll settings, persistent storage, and the
      project-specific Studio RPC used by the Torabo Tsuki editor.
```

## config/west.yml
```yaml
manifest:
  remotes:
    - name: zmkfirmware
      url-base: https://github.com/zmkfirmware
    - name: sekigon-gonnoc
      url-base: https://github.com/sekigon-gonnoc
  projects:
    - name: zmk
      remote: zmkfirmware
      revision: v0.3
      import: app/west.yml
    - name: zmk-component-bmp-boost
      remote: sekigon-gonnoc
      import: west.yml
      revision: v0.2
    - name: zmk-feature-status-led
      remote: sekigon-gonnoc
      revision: df1e324082c23c748c9ac377a9204535a470b734
    - name: zmk-driver-paw3222
      remote: sekigon-gonnoc
      revision: 0e1835c57f88d215ce401b6d0901f361629621fc
    - name: zmk-feature-cdc-acm-bootloader-trigger
      remote: sekigon-gonnoc
      revision: v0.2
    - name: zmk-feature-non-lipo-battery-management
      remote: sekigon-gonnoc
      revision: aa5b958ec6497f6057a1dfce5e731396aaf88374
  self:
    path: config
```

## dts/bindings/input_processors/torabo,input-processor-pointing-router.yaml
```yaml
# SPDX-License-Identifier: MIT
description: Four-direction pointing gesture processor
compatible: "torabo,input-processor-pointing-router"
include: ip_zero_param.yaml
properties:
  gesture-layer:
    type: int
    required: true
  threshold:
    type: int
    default: 24
  deadzone:
    type: int
    default: 2
  dominance-percent:
    type: int
    default: 150
  bindings:
    type: phandle-array
    required: true
```

## dts/bindings/input_processors/torabo,input-processor-pointing-settings.yaml
```yaml
# Copyright (c) 2026 shibaneko09
# SPDX-License-Identifier: MIT

description: Runtime cursor and scroll settings processor for Torabo Tsuki

compatible: "torabo,input-processor-pointing-settings"

include: ip_one_param.yaml
```
